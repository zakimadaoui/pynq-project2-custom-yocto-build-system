## meta-pynqz2/conf/layer.conf
```bitbake
# We have a conf and classes directory, add to BBPATH
BBPATH .= ":${LAYERDIR}"

# We have recipes-* directories, add to BBFILES
BBFILES += "${LAYERDIR}/recipes-*/*/*.bb \
            ${LAYERDIR}/recipes-*/*/*.bbappend"

BBFILE_COLLECTIONS += "meta-pynqz2"
BBFILE_PATTERN_meta-pynqz2 = "^${LAYERDIR}/"
BBFILE_PRIORITY_meta-pynqz2 = "6"

LAYERDEPENDS_meta-pynqz2 = "core"
LAYERSERIES_COMPAT_meta-pynqz2 = "kirkstone"
```

## meta-pynqz2/conf/machine/pynq-z2.conf
```bitbake
#@TYPE: Machine
#@NAME: pynq-z2
#@DESCRIPTION: Machine configuration for the pynq-z2 board. This machine configuration inherits most of the logic form 
# the machine configuration already provided by AMD Xilinx. See: meta-xilinx/meta-xilinx-core/conf/machine/README

# See: meta-xilinx/meta-xilinx-core/conf/machine/README
#### Preamble
MACHINEOVERRIDES =. "${@['', 'pynq-z2:']['pynq-z2' != '${MACHINE}']}"
#### Regular settings follow

# Only use ?=  for overriden variables before the `require` call. This is to allow local.conf/the user
# the still be able to override these variables. 

UBOOT_MACHINE ?= "xilinx_zynq_virt_defconfig" 
# Decide the u-boot .scr boot script to use. Choices can be `generic`, `generic.root`, `sd.zynq`
BOOTMODE ?= "generic.root"

require conf/machine/zynq-generic.conf

# Neither zynq-7000 nor Pynq-z2 offer an rtc 
MACHINE_FEATURES:remove = "rtc"

# Enable verbose boot for debugging boot issues
# KERNEL_ROOT_SD = "root=/dev/\${bootdev}2 rw rootwait debug initcall_debug ignore_loglevel log_buf_len=1M printk.time=1"

# Use Explicit fixed versions for kernel and u-boot
xlnx_kernel_ver = "6.12.10%"
PREFERRED_VERSION_linux-xlnx = "${xlnx_kernel_ver}"
xlnx_uboot_ver = "1:2025.01-xilinx-v2025.1%"
PREFERRED_VERSION_u-boot-xlnx = "${xlnx_uboot_ver}"
PREFERRED_VERSION_u-boot-tools-xlnx = "${xlnx_uboot_ver}"
PREFERRED_VERSION_u-boot-tools-xlnx-native = "${xlnx_uboot_ver}"


# Instruct yocto to use Wic tool to generate an SD Card image formatted to a boot (/boot) FAT32 and root (/) partitions
# we want both the .wic and .wic.gz. The compressed version is easier to transfer over ssh for example
IMAGE_FSTYPES += "wic wic.gz"
# use the xilix provided wks file for partiontioning the SD Card image
WKS_FILES = "xilinx-default-sd.wks" 

# Files to include in the /boot partion:
# BOOT.bin  which should include FSBL, bitstream and u-boot
IMAGE_BOOT_FILES:append = " boot.bin"
# U-boot script 
IMAGE_BOOT_FILES:append = " boot.scr"
# U-boot env file to be used with the boot.scr script
IMAGE_BOOT_FILES:append = " uEnv.txt"
# Linux kernel with u-boot headers
IMAGE_BOOT_FILES:append = " uImage"
# Bitstream binary firmware
IMAGE_BOOT_FILES:append = " download-${MACHINE}.bit.bin"


# FSBL, device-tree & bitstream common config
# we're using a (tweaked) xsct flow
XILINX_WITH_ESW="xsct"
XILINX_XSCT_VERSION="2024.2"
PREFERRED_PROVIDER_virtual/hdf = "pynq-hdf"

# First Stage Boot Loader (FSBL) config
# Because we do not follow the SDT flow. We need to build first stage bootloader ourselves or supply the
# name of recipe that builds it to the fsbl.bb recipe to use it as a dependency. This is done through the FSBL_DEPENDS variable.
FSBL_DEPENDS="fsbl-firmware:do_deploy"
# apperently there is already a recipe that provides fsbl instead of the one we created, we let's use xilinx one instead
# FSBL_DEPENDS="pynq-fsbl:do_deploy"

# bitstream config
# bitstream-extraction will extract bitstream from the hdf/xsa file provided by "virtual/hdf"
PREFERRED_PROVIDER_virtual/bitstream = "bitstream-extraction"
# enable fpga/pl device-tree overlay support.
# - This will affect how the device tree source and blob is generated. A system-top.dtb is generated which expects a pl.dtbo to be loaded lateron
# The pl.dtbo also needs to be accompanied with a .bit.bin file representing the bitstream firmware binary
# $ fpgautil -b /boot/download-pynq-z2.bit.bin -o /boot/devicetree/pl.dtbo -f Full -n full
MACHINE_FEATURES += "fpga-overlay"
# instruct xilinx-bootbin to add bitstream in the BOOT.bin file. This is necessary and it will act as a base bitstream 
# which can be updated at runtime afterwards. Without this, its not possible to program the FPGA after the device has booted
BIF_BITSTREAM_ATTR = "bitstream"
# set a fixed name for bitstream firmware in the generated `pl.dtsi`, otherwize `device-tree` recipe from `meta-xilinx-tools` will generate an undeterminitstic filename in `pl.dtsi`
YAML_FIRMWARE_NAME="download-${MACHINE}.bit"
# convert the bitstream extracted by "bitstream-extraction" to a binary blob to allow loading it at runtime
EXTRA_IMAGEDEPENDS += "bitstream-bin"
# add the generated .bit.bin file to /boot
WKS_FILE_DEPENDS += "bitstream-bin"
MACHINE_ESSENTIAL_EXTRA_RDEPENDS += "bitstream-bin"
# Install a service that loads the bitstream firmware and the associated device tree overlay at boot-time
IMAGE_INSTALL:append = " bitstream-load" 


# device-tree config
PREFERRED_PROVIDER_virtual/dtb = "device-tree"
# including system.dtb into boot files will automatically trigger the `device-tree` recipe (See: conf/machine/zynq-generic.conf)
IMAGE_BOOT_FILES += "system.dtb"
# skip adding device tree to the `boot.bin`. We will load device tree from u-boot instead
BIF_DEVICETREE_ATTR=""

# Zynq-7000 QEMU Configurations
QB_MACHINE = "-M xilinx-zynq-a9"
QB_MEM = "-m 1024"
QB_OPT_APPEND = "-serial mon:stdio -serial null"
QB_KERNEL_ROOT = "/dev/mmcblk0p2"
# use u-boot as the the default kernel to be able to also tweak u-boot if necessary
QB_DEFAULT_KERNEL = "boot.bin-extracted/u-boot.elf"
#### No additional settings should be after the Postamble
#### Postamble
PACKAGE_EXTRA_ARCHS:append = "${@['', ' pynq-z2']['pynq-z2' != "${MACHINE}"]}"
```
